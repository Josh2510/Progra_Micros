/*
* Proyecto_Reloj.asm
*
* Creado: 2/27/2026 4:30:42 PM
* Autor : Josue Eli Mata Ixcayau
* Descripci?n: Un reloj digital que permita mostrar hora y minutos, dias y meses, tambien programar una alarma a una hora especifica.
*/
/****************************************/
// Encabezado (Definici?n de Registros, Variables y Constantes)
.include "M328PDEF.inc"     // Include definitions specific to ATMega328P
.dseg
.org    SRAM_START
.equ	TCNT1_value = 0x0BDC
/****************************************/
//	Variables en SRAM
.dseg						// VARIABLE DENTRO DE SRAM
VALOR_MIN_U:		.byte   1   // VARIABLES DE MODIFICACION DE MINUTOS
VALOR_MIN_D:		.byte   1
VALOR_HORA_U:		.byte   1	// VARIABLES DE MODIFICACION DE HORAS
VALOR_HORA_D:		.byte   1
VALOR_DIA_U:		.byte	1	// VARIABLES DE MODIFICACION DE DIAS
VALOR_DIA_D:		.byte	1
VALOR_MES_U:		.byte	1	// VARIABLES DE MODIFICACION DE MESES
VALOR_MES_D:		.byte	1
A_MIN_U:			.byte	1	// VARIABLES DE MINUTOS PARA ALARMA
A_MIN_D:			.byte	1	
A_HORA_U:			.byte	1	// VARIABLES DE HORAS PARA ALARMA
A_HORA_D:			.byte	1
CONTEO_MESES:		.byte	1	// CONTADOR DE MESES PARA TABLA DE CANTIDAD DE DIAS
/****************************************/
//	CODIGO
.cseg
.org	0x0000
	JMP	START
.org	PCI1addr
	JMP	ISR_PCI1
.org	OVF1addr
	JMP	ISR_TMR1_OVF
.org	OVF0addr
	JMP	ISR_TMR0_OVF
// REGISTROS DEFINIDOS PARA VARIABLES ESPECIFICAS
.def	VALOR_C_ANTERIOR =		R0				// VALORES DE PINC DEL INICIO DEL PROGRAMA Y PARA HACER QUE FUNCIONEN BOTONES POR SEPARADO
.def	S_PORT =				R1				// SALIDA A PORTB
.def	CONTADOR_MULTI =		R2				// CONTADOR PARA MULTIPLEXADO
.def	MODO =					R3				// REGISTRO DE MODO
.def	MAX_MODES =				R5				// VALOR MAXIMO DE MODOS
.def	CONTADOR_MESES =		R6				// CONTADOR DE MES PARA DETERMINAR MAXIMO DE DIAS
.def	VARIABLE_DIAS =			R7				// VARIABLE QUE RECIBE EL MAXIMO DE DIAS
.def	VALOR_C_ACTUAL =		R10				// LECTURA ACTUAL DEL PINC
.def	ENTRADA_PINC =			R13				// REGISTRO PARA GUARDAR VALORES ACTUALES DE PINC
.def	REG_DISPLAY =			R14				// REGISTRO DE SALIDA PARA DISPLAYS
.def	S_DISPLAY =				R15				// SALIDA PARA DISPLAYS
.def	VARIABLE_TEMP_1 =		R17				// VARIABLES TEMPORALES
.def	VARIABLE_TEMP_2 =		R18				
.def	CONTADOR_TIEMPO =		R19				// CONTADOR DE TIEMPO PARA TIMER 1
.def	CONTADOR_ESTADO =		R20				// CONTADOR DE ESTADOS PARA INDICAR EN LEDS
.def	BANDERA_ACCION =		R21				// BANDERA DE ACCIONES
.def	BANDERA_ESTADO =		R22				// BANDERA DE ESTADOS
.def	PARPADEO_LED =			R23				// REGISTRO PARA PARPADEO DE LEDS

START:
 /****************************************/
// Configuraci?n de la pila
	LDI     R16, LOW(RAMEND)
	OUT     SPL, R16
	LDI     R16, HIGH(RAMEND)
	OUT     SPH, R16
/****************************************/
// CREACION DE TABLA PARA DISPLAY
Numero: .db 0x40, 0x79, 0x24, 0x30, 0x19, 0x12, 0x02, 0x78, 0x00, 0x10, 0x08, 0x03, 0x70, 0x21, 0x06, 0x0E
Cantidad_dias:	.db	0x00, 0x1F, 0x1C, 0x1F, 0x1E, 0x1F, 0x1E, 0x1F, 0x1F, 0x1E, 0x1F, 0x1E, 0x1F, 0x00
/****************************************/
// Configuracion MCU
SETUP:
    CLI									// DESHABILITAR INTERRUPCIONES GLOBALES
	// PRESCALER
	LDI		R16,	(1 << CLKPCE)
	STS		CLKPR,	R16					// HABILITAR CAMBIOS EN CLOCK PRINCIPAL PARA HABILITAR PRESCALER
	LDI		R16,	(1 << CLKPS2)
	STS		CLKPR,	R16					// CAMBIAR FRECUENCIA DE 16 MHz a 1MHz

	// TIMER
	CALL INIT_TMR0						// LLAMAR A INICIALIZACION DE TIMER
	CALL INIT_TMR1						//

    // ENTRADAS
	LDI		R16,	0x20			
	OUT		DDRC,	R16					// PONER EN ENTRADAS LOS BITS 0, 1, 2, 3 Y 4 DE PORTC
	LDI		R16,	0x1F				// VALOR PARA ACTIVAR PULL UPS
	OUT		PORTC,	R16					// HABILITAR PULL UPS EN PINC

	// SALIDAS
	LDI		R16,	0xFF				
	OUT		DDRB,	R16					// PONER EN SALIDAS LOS BITS DE PORTB
	OUT		DDRD,	R16					// PONER EN SALIDAS LOS BITS DE PORTD  

	LDI		R16,	0xFF
	OUT		PORTB,	R16					// PONER DE VALOR INICIAL PARA PORTB 0

		// DISPLAYS DE 7 SEGMENTOS
	LDI		ZL,		LOW(Numero<<1)		// INICIALIZAR PUNTERO Z
	LDI		ZH,		HIGH(Numero<<1)		//
	LPM		R16,	Z					// 
	OUT		PORTD,	R16					// PONER DE VALOR INICIAL PARA PORTD 0

	// HABILITACION DE INTERRUPCIONES
	LDI		R16,	(1 << PCIE1)		
    STS		PCICR,	R16					// HABILITA INTERRUPCIONES EN PORTC
    LDI		R16,	(1 << PCINT8) | (1 << PCINT9) | (1 << PCINT10) | (1 << PCINT11) | (1 << PCINT12)
    STS		PCMSK1, R16					// HABILITAR INTERRUPCIONES PARA BITS 0 A 4 DE PINC
	LDI		R16,	(1 << TOIE0)		// HABILITAR INTERRUPCIONES DE TIMER0
	STS		TIMSK0,	R16
	LDI		R16,	(1 << TOIE1)		// HABILITAR INTERRUPCIONES DE TIMER1
	STS		TIMSK1,	R16

	// VARIABLES A USAR
	IN		VALOR_C_ANTERIOR,	PINC		// VALORES DE PIN C
	LDI		R16,				0x00
	STS		VALOR_MIN_U,		R16			// REINICIAR VALORES DE VARIABLES
	STS		VALOR_MIN_D,		R16
	STS		VALOR_HORA_U,		R16
	STS		VALOR_HORA_D,		R16
	STS		VALOR_DIA_D,		R16
	STS		VALOR_MES_D,		R16
	STS		A_MIN_U,			R16
	STS		A_MIN_D,			R16
	STS		A_HORA_U,			R16
	STS		A_HORA_D,			R16
	MOV		CONTADOR_MULTI,		R16			// REINICIAR VALORES EN CONTADOR PARA MULTIPLEXADO
	LDI		R16,				0x01
	STS		VALOR_DIA_U,		R16
	STS		VALOR_MES_U,		R16
	STS		CONTEO_MESES,		R16
	LDI		R16,				5
	MOV		MAX_MODES,			R16	
	LDI		PARPADEO_LED,		0x80				
	CLR		VARIABLE_TEMP_1					// REINICIAR VARIABLES TEMPORALES
	CLR		VARIABLE_TEMP_2					
	CLR		CONTADOR_TIEMPO					// CONTADOR PARA TIEMPO
	CLR		REG_DISPLAY						// REGISTRO DONDE SE GUARDA VALOR QUE VA A SALIR A DISPLAY
	CLR		CONTADOR_ESTADO					// REINICIAR CONTADOR DE ESTADO
	CLR		BANDERA_ACCION					// REINICIAR BANDERAS
	CLR		BANDERA_ESTADO					//

	SEI										// HABILITAR INTERRUPCIONES GLOBALES
/****************************************/
// Loop Infinito
MAIN_LOOP:
	// ----------------------------------------------------------------------------------- //
	SBRC	BANDERA_ESTADO,		3			// COMPROBAR SI BANDERA DE SONAR BUZZER ESTA ENCENDIDA
	CALL	BUZZER
	// ----------------------------------------------------------------------------------- //
	LDI		R16,	0						// VERIFICAR EN QUE MODO ESTA
	CP		MODO,	R16
	BREQ	RELOJ
	LDI		R16,	1
	CP		MODO,	R16
	BREQ	FECHA
	LDI		R16,	2
	CP		MODO,	R16
	BREQ	MODIFICAR_RELOJ
	LDI		R16,	3
	CP		MODO,	R16
	BREQ	MODIFICAR_FECHA
	LDI		R16,	4
	CP		MODO,	R16
	BREQ	SET_ALARMA

RELOJ:
	SBR		BANDERA_ESTADO,	(1<<0)			// ENCENDER BIT 0 DE BANDERA ESTADO
	CBR		BANDERA_ESTADO,	(1<<1)			// APAGAR BIT 1 DE BANDERA DE ESTADO
	LDI		CONTADOR_ESTADO,	0x00		// CARGAR VALOR DE ESTADO PARA MOSTRAR EN LEDS
	CALL	SALIDA_DISPLAY_HORA
	RJMP	REGRESO_MAIN
FECHA:
	SBR		BANDERA_ESTADO,	(1<<0)			// ENCENDER BIT 0 DE BANDERA DE ESTADO
	CBR		BANDERA_ESTADO,	(1<<1)			// APAGAR BIT 1 DE BANDERA DE ESTADO
	LDI		CONTADOR_ESTADO,	0x01		// CARGAR VALOR DE ESTADO PARA MOSTRAR EN LEDS
	CALL	SALIDA_DISPLAY_FECHA
	RJMP	REGRESO_MAIN
MODIFICAR_RELOJ:
	SBR		BANDERA_ESTADO,	(1<<1)			// ENCENDER BIT 1 DE BANDERA DE ESTADO
	CBR		BANDERA_ESTADO,	(1<<0)			// APAGAR BIT 0 DE BANDERA DE ESTADO
	LDI		CONTADOR_ESTADO,	0x02		// CARGAR VALOR DE ESTADO PARA MOSTRAR EN LEDS
	CALL	CAMBIAR_RELOJ
	CALL	SALIDA_DISPLAY_HORA
	RJMP	REGRESO_MAIN
MODIFICAR_FECHA:
	SBR		BANDERA_ESTADO,	(1<<1)			// ENCENDER BIT 1 DE BANDERA DE ESTADO
	CBR		BANDERA_ESTADO,	(1<<0)			// APAGAR BIT 0 DE BANDERA DE ESTADO
	LDI		CONTADOR_ESTADO,	0x03		// CARGAR VALOR DE ESTADO PARA MOSTRAR EN LEDS
	CALL	CAMBIAR_FECHA
	CALL	SALIDA_DISPLAY_FECHA
	RJMP	REGRESO_MAIN
SET_ALARMA:
	SBR		BANDERA_ESTADO,	(1<<0)			// ENCENDER BIT 0 DE BANDERA DE ESTADO
	CBR		BANDERA_ESTADO,	(1<<1)			// APAGAR BIT 1 DE BANDERA DE ESTADO
	LDI		CONTADOR_ESTADO,	0x00		// CARGAR VALOR DE ESTADO PARA MOSTRAR EN LEDS
	CALL	SETEAR_ALARMA
	CALL	SALIDA_DISPLAY_ALARMA
	RJMP	REGRESO_MAIN
REGRESO_MAIN:
    RJMP    MAIN_LOOP

/****************************************/
// NON-Interrupt subroutines
INIT_TMR0:
	LDI		R16,	(1 << CS01)			// CONFIGURANDO PRESCALER DE I/O A 8
	OUT		TCCR0B,	R16
	LDI		R16,	131					// SE GUARDA EN R16 EL VALOR DE INICIO DEL TIMER
	OUT		TCNT0,	R16					// GUARDA VALORES INICIALES DE TIMER 0 EN TCNT0
	RET
//----------------------------------------------------------------------------------------//
INIT_TMR1:
	LDI		R16,	0x00
	STS		TCCR1A,	R16
	LDI		R16,	(1 << CS11)			// CONFIGURAR PRESCALER DE I/O A 8
	STS		TCCR1B,	R16
	LDI		R16,	HIGH(TCNT1_value)	// CARGAR EN R16 LA PARTE SUPERIOR DEL VALOR INICIAL DEL TIMER
	STS		TCNT1H,	R16
	LDI		R16,	LOW(TCNT1_value)	// CARGAR EN R16 LA PARTE INFERIOR DEL VALOR INICIAL DEL TIMER
	STS		TCNT1L,	R16
	RET
//----------------------------------------------------------------------------------------//
SALIDA_DISPLAY_HORA:
	CLR		S_DISPLAY
	OUT		PORTB,		S_PORT				// MANDAMOS REGISTRO A PORTB

	SBRC	S_PORT,	0						// SKIP IF BIT IN REGISTER IS SET
	LDS		REG_DISPLAY,	VALOR_MIN_U		// MOVER VALOR DE UNIDADES A REGISTRO DE DISPLAY

	SBRC	S_PORT,	1						// SKIP IF BIT IN REGISTER IS SET
	LDS		REG_DISPLAY,	VALOR_MIN_D		// MOVER VALOR DE DECENAS A REGISTRO DE DISPLAY
	
	SBRC	S_PORT,	2						// SKIP IF BIT IN REGISTER IS SET
	LDS		REG_DISPLAY,	VALOR_HORA_U	// MOVER VALOR DE UNIDADES A REGISTRO DE DISPLAY

	SBRC	S_PORT,	3						// SKIP IF BIT IN REGISTER IS SET
	LDS		REG_DISPLAY,	VALOR_HORA_D	// MOVER VALOR DE DECENAS A REGISTRO DE DISPLAY

	LDI		ZL,		LOW(Numero<<1)			// REINICIAMOS PUNTEROS
	LDI		ZH,		HIGH(Numero<<1)			//
	ADD		ZL,		REG_DISPLAY				// SUMAMOS A PARTE BAJA DE PUNTERO CONTADOR DE DISPLAY
	LPM		S_DISPLAY,	Z					// MANDAMOS VALOR DE Z A REGISTRO DE SALIDA
	OR		S_DISPLAY,	PARPADEO_LED
	OUT		PORTD,	S_DISPLAY
	RET
//----------------------------------------------------------------------------------------//
SALIDA_DISPLAY_FECHA:
	CLR		S_DISPLAY
	OUT		PORTB,		S_PORT				// MANDAMOS REGISTRO A PORTB

	SBRC	S_PORT,	0						// SKIP IF BIT IN REGISTER IS SET
	LDS		REG_DISPLAY,	VALOR_MES_U		// MOVER VALOR DE UNIDADES A REGISTRO DE DISPLAY

	SBRC	S_PORT,	1						// SKIP IF BIT IN REGISTER IS SET
	LDS		REG_DISPLAY,	VALOR_MES_D		// MOVER VALOR DE DECENAS A REGISTRO DE DISPLAY
	
	SBRC	S_PORT,	2						// SKIP IF BIT IN REGISTER IS SET
	LDS		REG_DISPLAY,	VALOR_DIA_U		// MOVER VALOR DE UNIDADES A REGISTRO DE DISPLAY

	SBRC	S_PORT,	3						// SKIP IF BIT IN REGISTER IS SET
	LDS		REG_DISPLAY,	VALOR_DIA_D		// MOVER VALOR DE DECENAS A REGISTRO DE DISPLAY

	LDI		ZL,		LOW(Numero<<1)			// REINICIAMOS PUNTEROS
	LDI		ZH,		HIGH(Numero<<1)			//
	ADD		ZL,		REG_DISPLAY				// SUMAMOS A PARTE BAJA DE PUNTERO CONTADOR DE DISPLAY
	LPM		S_DISPLAY,	Z					// MANDAMOS VALOR DE Z A REGISTRO DE SALIDA
	OR		S_DISPLAY,	PARPADEO_LED
	OUT		PORTD,	S_DISPLAY
	RET
//----------------------------------------------------------------------------------------//
SALIDA_DISPLAY_ALARMA:
	SBRC	BANDERA_ESTADO,	4				// VERIFICAR SI BANDERA DE PARPADEO DE ALARMA ESTA ACTIVADO
	RET

	CLR		S_DISPLAY
	OUT		PORTB,		S_PORT				// MANDAMOS REGISTRO A PORTB

	SBRC	S_PORT,	0						// SKIP IF BIT IN REGISTER IS SET
	LDS		REG_DISPLAY,	A_MIN_U			// MOVER VALOR DE UNIDADES A REGISTRO DE DISPLAY

	SBRC	S_PORT,	1						// SKIP IF BIT IN REGISTER IS SET
	LDS		REG_DISPLAY,	A_MIN_D			// MOVER VALOR DE DECENAS A REGISTRO DE DISPLAY
	
	SBRC	S_PORT,	2						// SKIP IF BIT IN REGISTER IS SET
	LDS		REG_DISPLAY,	A_HORA_U		// MOVER VALOR DE UNIDADES A REGISTRO DE DISPLAY

	SBRC	S_PORT,	3						// SKIP IF BIT IN REGISTER IS SET
	LDS		REG_DISPLAY,	A_HORA_D		// MOVER VALOR DE DECENAS A REGISTRO DE DISPLAY

	LDI		ZL,			LOW(Numero<<1)		// REINICIAMOS PUNTEROS
	LDI		ZH,			HIGH(Numero<<1)			
	ADD		ZL,			REG_DISPLAY			// SUMAMOS A PARTE BAJA DE PUNTERO CONTADOR DE DISPLAY
	LPM		S_DISPLAY,	Z					// MANDAMOS VALOR DE Z A REGISTRO DE SALIDA
	OR		S_DISPLAY,	PARPADEO_LED
	OUT		PORTD,		S_DISPLAY
	RET
//----------------------------------------------------------------------------------------//
CAMBIAR_RELOJ:
	IN		ENTRADA_PINC,		PINC				// SE LEE EL PIN C
	MOV		VALOR_C_ACTUAL,		ENTRADA_PINC		// MOVEMOS REGISTRO R16 A R5
	EOR		VALOR_C_ACTUAL,		VALOR_C_ANTERIOR	// XOR ENTRE VALORES ACTUALES Y VALORES ANTERIORES
	MOV		VALOR_C_ANTERIOR,	ENTRADA_PINC		// MOVEMOS VALORES ACTUALES A VALORES ANTERIORES

	SBRC	VALOR_C_ACTUAL,		0					// SKIP IF BIT IN REGISTER IS CLEAR
	CALL	BIT_0
	SBRC	VALOR_C_ACTUAL,		1					// SKIP IF BIT IN REGISTER IS CLEAR
	CALL	BIT_1
	SBRC	VALOR_C_ACTUAL,		2					// SKIP IF BIT IN REGISTER IS CLEAR
	CALL	BIT_2
	SBRC	VALOR_C_ACTUAL,		3					// SKIP IF BIT IN REGISTER IS CLEAR
	CALL	BIT_3
	RET
//----------------------------------------------------------------------------------------//
CAMBIAR_FECHA:
	IN		ENTRADA_PINC,		PINC				// SE LEE EL PIN C
	MOV		VALOR_C_ACTUAL,		ENTRADA_PINC		// MOVEMOS REGISTRO R16 A R5
	EOR		VALOR_C_ACTUAL,		VALOR_C_ANTERIOR	// XOR ENTRE VALORES ACTUALES Y VALORES ANTERIORES
	MOV		VALOR_C_ANTERIOR,	ENTRADA_PINC		// MOVEMOS VALORES ACTUALES A VALORES ANTERIORES

	SBRC	VALOR_C_ACTUAL,		0					// SKIP IF BIT IN REGISTER IS CLEAR
	CALL	BIT_0
	SBRC	VALOR_C_ACTUAL,		1					// SKIP IF BIT IN REGISTER IS CLEAR
	CALL	BIT_1
	SBRC	VALOR_C_ACTUAL,		2					// SKIP IF BIT IN REGISTER IS CLEAR
	CALL	BIT_2
	SBRC	VALOR_C_ACTUAL,		3					// SKIP IF BIT IN REGISTER IS CLEAR
	CALL	BIT_3
	RET
//----------------------------------------------------------------------------------------//
SETEAR_ALARMA:
	IN		ENTRADA_PINC,		PINC				// SE LEE EL PIN C
	MOV		VALOR_C_ACTUAL,		ENTRADA_PINC		// MOVEMOS REGISTRO R16 A R5
	EOR		VALOR_C_ACTUAL,		VALOR_C_ANTERIOR	// XOR ENTRE VALORES ACTUALES Y VALORES ANTERIORES
	MOV		VALOR_C_ANTERIOR,	ENTRADA_PINC		// MOVEMOS VALORES ACTUALES A VALORES ANTERIORES

	SBRC	VALOR_C_ACTUAL,		0					// SKIP IF BIT IN REGISTER IS CLEAR
	CALL	BIT_0
	SBRC	VALOR_C_ACTUAL,		1					// SKIP IF BIT IN REGISTER IS CLEAR
	CALL	BIT_1
	SBRC	VALOR_C_ACTUAL,		2					// SKIP IF BIT IN REGISTER IS CLEAR
	CALL	BIT_2
	SBRC	VALOR_C_ACTUAL,		3					// SKIP IF BIT IN REGISTER IS CLEAR
	CALL	BIT_3
	RET
//----------------------------------------------------------------------------------------//
BIT_0:
	SBRC	BANDERA_ACCION,	0				// COMPRUEBA QUE BIT ESTA ENCENDIDO
	RJMP	AU_HORA							// PARA HACER LA INSTRUCCION CORRECTA
	SBRC	BANDERA_ACCION,	1
	RJMP	AU_DIA
	SBRC	BANDERA_ACCION,	2
	RJMP	AU_HORA_ALARMA
	RJMP	SALIDA_BIT_0
AU_HORA:
	SBRS	ENTRADA_PINC,	0				// SKIP IF BIT IN REGISTER IS SET
	CALL	AUMENTO_HORA
	RJMP	SALIDA_BIT_0
AU_DIA:
	SBRS	ENTRADA_PINC,	0				// SKIP IF BIT IN REGISTER IS SET
	CALL	AUMENTO_DIA
	RJMP	SALIDA_BIT_0
AU_HORA_ALARMA:
	SBRS	ENTRADA_PINC,	0				// SKIP IF BIT IN REGISTER IS SET
	CALL	AUMENTO_HORA_ALARMA
	RJMP	SALIDA_BIT_0
SALIDA_BIT_0:
	RET
//----------------------------------------------------------------------------------------//
BIT_1:
	SBRC	BANDERA_ACCION,	0				// COMPRUEBA QUE BIT ESTA ENCENDIDO
	RJMP	DE_HORA							// PARA HACER LA INSTRUCCION CORRECTA
	SBRC	BANDERA_ACCION,	1
	RJMP	DE_DIA
	SBRC	BANDERA_ACCION,	2
	RJMP	DE_HORA_ALARMA
	RJMP	SALIDA_BIT_1
DE_HORA:
	SBRS	ENTRADA_PINC,	1				// SKIP IF BIT IN REGISTER IS SET
	CALL	DISMINUYE_HORA
	RJMP	SALIDA_BIT_0
DE_DIA:
	SBRS	ENTRADA_PINC,	1				// SKIP IF BIT IN REGISTER IS SET
	CALL	DISMINUYE_DIA
	RJMP	SALIDA_BIT_0
DE_HORA_ALARMA:
	SBRS	ENTRADA_PINC,	1				// SKIP IF BIT IN REGISTER IS SET
	CALL	DISMINUYE_HORA_ALARMA
	RJMP	SALIDA_BIT_0
SALIDA_BIT_1:
	RET
//----------------------------------------------------------------------------------------//
BIT_2:
	SBRC	BANDERA_ACCION,	0				// COMPRUEBA QUE BIT ESTA ENCENDIDO
	RJMP	AU_MIN							// PARA HACER LA INSTRUCCION CORRECTA
	SBRC	BANDERA_ACCION,	1
	RJMP	AU_MES
	SBRC	BANDERA_ACCION,	2
	RJMP	AU_MIN_ALARMA
	RJMP	SALIDA_BIT_2
AU_MIN:
	SBRS	ENTRADA_PINC,	2				// SKIP IF BIT IN REGISTER IS SET
	CALL	AUMENTO_MIN
	RJMP	SALIDA_BIT_2
AU_MES:
	SBRS	ENTRADA_PINC,	2				// SKIP IF BIT IN REGISTER IS SET
	CALL	AUMENTO_MES
	RJMP	SALIDA_BIT_2
AU_MIN_ALARMA:
	SBRS	ENTRADA_PINC,	2				// SKIP IF BIT IN REGISTER IS SET
	CALL	AUMENTO_MIN_ALARMA
	RJMP	SALIDA_BIT_2
SALIDA_BIT_2:
	RET
//----------------------------------------------------------------------------------------//
BIT_3:
	SBRC	BANDERA_ACCION,	0				// COMPRUEBA QUE BIT ESTA ENCENDIDO
	RJMP	DE_MIN							// PARA HACER LA INSTRUCCION CORRECTA
	SBRC	BANDERA_ACCION,	1
	RJMP	DE_MES
	SBRC	BANDERA_ACCION,	2
	RJMP	DE_MIN_ALARMA
	RJMP	SALIDA_BIT_3
DE_MIN:
	SBRS	ENTRADA_PINC,	3				// SKIP IF BIT IN REGISTER IS SET
	CALL	DISMINUYE_MIN
	RJMP	SALIDA_BIT_3
DE_MES:
	SBRS	ENTRADA_PINC,	3				// SKIP IF BIT IN REGISTER IS SET
	CALL	DISMINUYE_MES
	RJMP	SALIDA_BIT_3
DE_MIN_ALARMA:
	SBRS	ENTRADA_PINC,	3				// SKIP IF BIT IN REGISTER IS SET
	CALL	DISMINUYE_MIN_ALARMA
	RJMP	SALIDA_BIT_3
SALIDA_BIT_3:
	RET
//----------------------------------------------------------------------------------------//
AUMENTO_MIN:
	LDS		VARIABLE_TEMP_1,	VALOR_MIN_U	// CARGAR VALORES DESDE LA SRAM
	LDS		VARIABLE_TEMP_2,	VALOR_MIN_D

	INC		VARIABLE_TEMP_1					// AUMENTO VALOR DE UNIDADES
	CPI		VARIABLE_TEMP_1,	0x0A		// COMPARO CON 10
	BRNE	SALIDA_AUMENTO_MIN
	CLR		VARIABLE_TEMP_1

	INC		VARIABLE_TEMP_2					// AUMENTO VALOR DE DECENAS
	CPI		VARIABLE_TEMP_2,	0x06		// COMPARO CON 6
	BRNE	SALIDA_AUMENTO_MIN
	CLR		VARIABLE_TEMP_2
SALIDA_AUMENTO_MIN:
	STS		VALOR_MIN_U,	VARIABLE_TEMP_1	// GUARDAR VALORES EN LA SRAM
	STS		VALOR_MIN_D,	VARIABLE_TEMP_2
	RET
//----------------------------------------------------------------------------------------//
AUMENTO_HORA:
	LDS		VARIABLE_TEMP_1,	VALOR_HORA_U	// CARGAR VALORES DESDE LA SRAM
	LDS		VARIABLE_TEMP_2,	VALOR_HORA_D
	CPI		VARIABLE_TEMP_2,	0x02
	BREQ	C_2_HORAS

	INC		VARIABLE_TEMP_1					// AUMENTO VALOR DE UNIDADES
	CPI		VARIABLE_TEMP_1,	0x0A		// COMPARO CON 10
	BRNE	SALIDA_AUMENTO_HORA
	CLR		VARIABLE_TEMP_1					// REINICIO CONTADOR DE UNIDADES
	RJMP	C_D_HORAS

C_2_HORAS:
	INC		VARIABLE_TEMP_1					// AUMENTO VALOR DE UNIDADES
	CPI		VARIABLE_TEMP_1,	0x04		// COMPARO CON 4
	BRNE	SALIDA_AUMENTO_HORA
	CLR		VARIABLE_TEMP_1					// REINICIO CONTADOR DE UNIDADES
	RJMP	C_D_HORAS

C_D_HORAS:
	INC		VARIABLE_TEMP_2					// AUMENTO VALOR DE DECENAS
	CPI		VARIABLE_TEMP_2,	0x03		// COMPARO CON 6
	BRNE	SALIDA_AUMENTO_HORA
	CLR		VARIABLE_TEMP_1					// REINICIO CONTADOR DE DECENAS
	CLR		VARIABLE_TEMP_2					// REINICIO CONTADOR DE UNIDADES
SALIDA_AUMENTO_HORA:
	STS		VALOR_HORA_U,	VARIABLE_TEMP_1	// GUARDAR VALORES EN LA SRAM
	STS		VALOR_HORA_D,	VARIABLE_TEMP_2				
	RET
//----------------------------------------------------------------------------------------//
AUMENTO_DIA:
	LDS		VARIABLE_TEMP_1,	VALOR_DIA_U	// CARGAR VALORES DESDE LA SRAM
	LDS		VARIABLE_TEMP_2,	VALOR_DIA_D
	LDS		CONTADOR_MESES,		CONTEO_MESES

	LDI		ZL,		LOW(Cantidad_dias<<1)	// REINICIAMOS PUNTEROS DIAS
	LDI		ZH,		HIGH(Cantidad_dias<<1)
	ADD		ZL,		CONTADOR_MESES
	LPM		VARIABLE_DIAS,	Z

	CPI		VARIABLE_TEMP_2,	0x03		// COMPROBAMOS SI DECENAS DE DIA ES 3
	BREQ	C_3_DIAS						// PARA COMPROBAR SI EL MAXIMO DE DIAS ES 30 O 31
	CPI		VARIABLE_TEMP_2,	0x02		// COMPROBAMOS SI DECENAS EN DIA ES 2
	BREQ	C_2_DIAS						// PARA COMPROBAR SI EL MAXIMO DE DIAS ES 28

	C_1_DIAS:
	INC		VARIABLE_TEMP_1					// AUMENTO VALOR DE UNIDADES
	CPI		VARIABLE_TEMP_1,	0x0A		// COMPARO CON 2
	BRNE	SALIDA_AUMENTO_DIA					
	CLR		VARIABLE_TEMP_1					// REINICIO POR OVERFLOW
	RJMP	C_D_DIAS

	C_2_DIAS:
	LDI		R16,	28
	CP		VARIABLE_DIAS,	R16				// COMPRUEBO SI EL MAXIMO ES 28
	BREQ	C_2_FEBRERO_DIAS				// SI ES ASI SALTO A CONTADOR DE FEBRERO, SI NO CONTINUO NORMAL
	INC		VARIABLE_TEMP_1					// AUMENTO VALOR DE UNIDADES
	CPI		VARIABLE_TEMP_1,	0x0A		// COMPARO CON 10
	BRNE	SALIDA_AUMENTO_DIA
	CLR		VARIABLE_TEMP_1					// REINICIO POR OVERFLOW
	RJMP	C_D_DIAS
	C_2_FEBRERO_DIAS:
	INC		VARIABLE_TEMP_1					// AUMENTO VALOR DE UNIDADES
	CPI		VARIABLE_TEMP_1,	0x09		// COMPARO CON 9
	BRNE	SALIDA_AUMENTO_DIA
	CLR		VARIABLE_TEMP_2					// LIMPIAMOS VARIABLE DE DECENAS
    LDI		VARIABLE_TEMP_1, 0x01			// REINICIAMOS CONTADOR DE DIAS
    RJMP	SALIDA_AUMENTO_DIA				// SALTAMOS DIRECTAMENTE A LA SALIDA

	C_3_DIAS:
	LDI		R16,	31						// COMPRUEBA SI EL MAXIMO ES 31 DIAS
	CP		VARIABLE_DIAS,	R16
	BREQ	C_3_1_DIAS						
	LDI		R16,	30						// COMPRUEBA SI EL MAXIMO ES 30 DIAS
	CP		VARIABLE_DIAS,	R16		
	BREQ	C_3_2_DIAS
	C_3_1_DIAS:
	INC		VARIABLE_TEMP_1					// AUMENTO VALOR DE UNIDADES
	CPI		VARIABLE_TEMP_1,	0x02		// COMPARO CON 2
	BRNE	SALIDA_AUMENTO_DIA
	CLR		VARIABLE_TEMP_1					// REINICIO POR OVERFLOW
	RJMP	C_D_DIAS
	C_3_2_DIAS:
	INC		VARIABLE_TEMP_1					// AUMENTO VALOR DE UNIDADES
	CPI		VARIABLE_TEMP_1,	0x01		// COMPARO CON 1
	BRNE	SALIDA_AUMENTO_DIA
	CLR		VARIABLE_TEMP_1					// REINICIO POR OVERFLOW
	RJMP	C_D_DIAS
	
	C_D_DIAS:
	INC		VARIABLE_TEMP_2					// AUMENTO VALOR DE DECENAS
	CPI		VARIABLE_TEMP_2,	0x04		// COMPARO CON 4
	BRNE	SALIDA_AUMENTO_DIA
	CLR		VARIABLE_TEMP_2					// REINICIO POR OVERFLOW
	LDI		VARIABLE_TEMP_1,	0x01		// REINICIO POR OVERFLOW
SALIDA_AUMENTO_DIA:
	STS		VALOR_DIA_U,	VARIABLE_TEMP_1	// GUARDAR VALORES EN LA SRAM
	STS		VALOR_DIA_D,	VARIABLE_TEMP_2
	RET
//----------------------------------------------------------------------------------------//
AUMENTO_MES:
	LDS		VARIABLE_TEMP_1,	VALOR_MES_U	// CARGAR VALORES DESDE LA SRAM
	LDS		VARIABLE_TEMP_2,	VALOR_MES_D
	LDS		CONTADOR_MESES,		CONTEO_MESES
	
	LDI		ZL,		LOW(Cantidad_dias<<1)	// REINICIAMOS PUNTEROS DIAS
	LDI		ZH,		HIGH(Cantidad_dias<<1)
	ADD		ZL,		CONTADOR_MESES
	LPM		VARIABLE_DIAS,	Z

	CPI		VARIABLE_TEMP_2,	0x01		// COMPROBAMOS DECENAS PARA VER SI SALTADOS
	BREQ	C_2_MESES						// A MESES 10, 11 Y 12

	C_1_MESES:
	INC		CONTADOR_MESES					// AUMENTA CONTADOR DE MESES
	INC		VARIABLE_TEMP_1					// AUMENTO VALOR DE UNIDADES
	CPI		VARIABLE_TEMP_1,	0x0A			// COMPARO CON 10
	BRNE	SALIDA_AUMENTO_MES
	CLR		VARIABLE_TEMP_1					// REINICIO POR OVERFLOW
	RJMP	C_D_MESES
	C_2_MESES:
	INC		CONTADOR_MESES					// AUMENTA CONTADOR DE MESES
	INC		VARIABLE_TEMP_1					// AUMENTO VALOR DE UNIDADES
	CPI		VARIABLE_TEMP_1,	0x03		// COMPARO CON 3
	BRNE	SALIDA_AUMENTO_MES
	LDI		VARIABLE_TEMP_1,	0x01		// REINICIAR VALORES DESPUES DE OVERFLOW
	LDI		R16,			0x01			// REINICIO DE CONTADOR DE MESES POR OVERFLOW
	MOV		CONTADOR_MESES,	R16
	RJMP	C_D_MESES

	C_D_MESES:
	INC		VARIABLE_TEMP_2					// AUMENTO VALOR DE DECENAS
	CPI		VARIABLE_TEMP_2,	0x02		// COMPARO CON 2
	BRNE	SALIDA_AUMENTO_MES
	CLR		VARIABLE_TEMP_2					// REINICIO DE CONTADOR DE MESES
	LDI		VARIABLE_TEMP_1,	0x01		// REINICIO DE CONTADOR DE MESES
	SALIDA_AUMENTO_MES:
	STS		VALOR_MES_U,	VARIABLE_TEMP_1	// GUARDO VALORES EN SRAM
	STS		VALOR_MES_D,	VARIABLE_TEMP_2
	STS		CONTEO_MESES,	CONTADOR_MESES
	RET
//----------------------------------------------------------------------------------------//
AUMENTO_MIN_ALARMA:
	LDS		VARIABLE_TEMP_1,	A_MIN_U		// LEO VALORES DE SRAM
	LDS		VARIABLE_TEMP_2,	A_MIN_D

	INC		VARIABLE_TEMP_1					// AUMENTO VALOR DE UNIDADES
	CPI		VARIABLE_TEMP_1,	0x0A		// COMPARO CON 10
	BRNE	SALIDA_ALARMA_AUMENTO_MIN
	CLR		VARIABLE_TEMP_1					// REINICIO POR OVERFLOW

	INC		VARIABLE_TEMP_2					// AUMENTO VALOR DE DECENAS
	CPI		VARIABLE_TEMP_2,	0x06		// COMPARO CON 6
	BRNE	SALIDA_ALARMA_AUMENTO_MIN
	CLR		VARIABLE_TEMP_2					// REINICIO CONTADOR DE MINUTOS
SALIDA_ALARMA_AUMENTO_MIN:
	STS		A_MIN_U,	VARIABLE_TEMP_1		// GUARDO EN SRAM
	STS		A_MIN_D,	VARIABLE_TEMP_2
	RET
//----------------------------------------------------------------------------------------//
AUMENTO_HORA_ALARMA:
	LDS		VARIABLE_TEMP_1,	A_HORA_U	// LEO EN SRAM
	LDS		VARIABLE_TEMP_2,	A_HORA_D
	CPI		VARIABLE_TEMP_2,	0x02
	BREQ	C_A_2_HORAS

	INC		VARIABLE_TEMP_1					// AUMENTO VALOR DE UNIDADES
	CPI		VARIABLE_TEMP_1,	0x0A		// COMPARO CON 10
	BRNE	SALIDA_ALARMA_AUMENTO_HORA
	CLR		VARIABLE_TEMP_1					// REINICIO CONTADOR DE UNIDADES
	RJMP	C_A_D_HORAS

C_A_2_HORAS:
	INC		VARIABLE_TEMP_1					// AUMENTO VALOR DE UNIDADES
	CPI		VARIABLE_TEMP_1,	0x04		// COMPARO CON 4
	BRNE	SALIDA_ALARMA_AUMENTO_HORA
	CLR		VARIABLE_TEMP_1					// REINICIO CONTADOR DE UNIDADES
	RJMP	C_A_D_HORAS

C_A_D_HORAS:
	INC		VARIABLE_TEMP_2					// AUMENTO VALOR DE DECENAS
	CPI		VARIABLE_TEMP_2,	0x03		// COMPARO CON 6
	BRNE	SALIDA_ALARMA_AUMENTO_HORA
	CLR		VARIABLE_TEMP_2					// REINICIO CONTADOR DE DECENAS
	CLR		VARIABLE_TEMP_1					// REINICIO CONTADOR DE UNIDADES
SALIDA_ALARMA_AUMENTO_HORA:
	STS		A_HORA_U,	VARIABLE_TEMP_1		// GUARDO EN SRAM
	STS		A_HORA_D,	VARIABLE_TEMP_2
	RET
//----------------------------------------------------------------------------------------//
DISMINUYE_MIN:
	LDS		VARIABLE_TEMP_1,	VALOR_MIN_U	// LEO DE SRAM
	LDS		VARIABLE_TEMP_2,	VALOR_MIN_D

	DEC		VARIABLE_TEMP_1					// DECREMENTO VALOR DE UNIDADES
	CPI		VARIABLE_TEMP_1,	0xFF		// COMPARO CON FF PARA VALIDAR EL 0
	BRNE	SALIDA_DECREMENTO_MIN			
	LDI		VARIABLE_TEMP_1,	0x09		// REINICIO POR UNDERFLOW

	DEC		VARIABLE_TEMP_2					// AUMENTO VALOR DE DECENAS
	CPI		VARIABLE_TEMP_2,	0xFF		// COMPARO CON FF PARA VALIDAR EL 0
	BRNE	SALIDA_DECREMENTO_MIN
	LDI		VARIABLE_TEMP_2,	0x05		// REINICIO POR UNDERFLOW
SALIDA_DECREMENTO_MIN:
	STS		VALOR_MIN_U,	VARIABLE_TEMP_1	// GUARDO EN SRAM
	STS		VALOR_MIN_D,	VARIABLE_TEMP_2
	RET
//----------------------------------------------------------------------------------------//
DISMINUYE_HORA:
	LDS		VARIABLE_TEMP_1,	VALOR_HORA_U	// LEO EN SRAM
	LDS		VARIABLE_TEMP_2,	VALOR_HORA_D

	DEC		VARIABLE_TEMP_1						// DECREMETO VALOR DE UNIDADES
	CPI		VARIABLE_TEMP_1,	0xFF			// COMPARO CON FF
	BRNE	SALIDA_DECREMENTO_HORA
	LDI		VARIABLE_TEMP_1,	0x09			// REINICIO CONTADOR DE UNIDADES
	RJMP	D_D_HORAS

D_D_HORAS:
	DEC		VARIABLE_TEMP_2						// AUMENTO VALOR DE DECENAS
	CPI		VARIABLE_TEMP_2,	0xFF			// COMPARO CON FF PARA VALIDAR 0
	BRNE	SALIDA_DECREMENTO_HORA
	LDI		VARIABLE_TEMP_2,	0x02			// REINICIO CONTADOR DE DECENAS
	LDI		VARIABLE_TEMP_1,	0x03			// REINICIO CONTADOR DE UNIDADES
SALIDA_DECREMENTO_HORA:
	STS		VALOR_HORA_U,	VARIABLE_TEMP_1	
	STS		VALOR_HORA_D,	VARIABLE_TEMP_2
	RET
//----------------------------------------------------------------------------------------//
DISMINUYE_DIA:
	LDS		VARIABLE_TEMP_1,	VALOR_DIA_U		// LEO DE SRAM
	LDS		VARIABLE_TEMP_2,	VALOR_DIA_D
	LDS		CONTADOR_MESES,		CONTEO_MESES

	LDI		ZL,		LOW(Cantidad_dias<<1)		// REINICIAMOS PUNTEROS DIAS
	LDI		ZH,		HIGH(Cantidad_dias<<1)
	ADD		ZL,		CONTADOR_MESES
	LPM		VARIABLE_DIAS,	Z

	CPI		VARIABLE_TEMP_2,	0x00			// COMPRUEBO EL VALOR DE DECENAS PARA VER SI LLEGO A 0
	BRNE	DECREMENTO_NORMAL					// SI NO LLEGO A 0, SIGUE DECREMENTANDO NORMAL
	CPI		VARIABLE_TEMP_1,	0x01			// SI LLEGA A 0 REVISA SI LAS UNIDADES ES 1
	BREQ	SALTO_TOPE							// PARA SALTAR HACIA EL MAXIMO DE DIAS

DECREMENTO_NORMAL:		
	DEC		VARIABLE_TEMP_1						// DECREMENTA UNIDADES
	CPI		VARIABLE_TEMP_1,	0xFF			// COMPARA CON FF PARA VALIDAR EL 0
	BRNE	SALIDA_DECREMENTO_DIA
	LDI		VARIABLE_TEMP_1,	0x09			// CARGA 9 PORQUE DE 20 PASA A 19 Y DE 10 PASA A 09
	DEC		VARIABLE_TEMP_2						// DECREMENTA DECENAS
	RJMP	SALIDA_DECREMENTO_DIA

SALTO_TOPE:
	LDI		R16,				28				// COMPRUEBA SI EL MAXIMO DE DIAS ES 28
	CP		VARIABLE_DIAS,		R16				// SI ASI ES, SALTA A FEBRERO
	BREQ	FEBRERO
	LDI		R16,				30				// COMPRUEBA SI EL MAXIMO DE DIAS ES 30
	CP		VARIABLE_DIAS,		R16				// SI ES ASI, SALTA A 30 DIAS
	BREQ	DIAS_30

	LDI		VARIABLE_TEMP_1,	0x01			// SI NO SIGUE A 31 DIAS Y CARGA LOS VALORES CORRESPONDIENTES
	LDI		VARIABLE_TEMP_2,	0x03
	RJMP	SALIDA_DECREMENTO_DIA
	DIAS_30:
	LDI		VARIABLE_TEMP_1,	0x00
	LDI		VARIABLE_TEMP_2,	0x03
	RJMP	SALIDA_DECREMENTO_DIA
	FEBRERO:
	LDI		VARIABLE_TEMP_1,	0x08
	LDI		VARIABLE_TEMP_2,	0x02
	RJMP	SALIDA_DECREMENTO_DIA


SALIDA_DECREMENTO_DIA:
	STS		VALOR_DIA_U,	VARIABLE_TEMP_1		// GUARDA EN SRAM
	STS		VALOR_DIA_D,	VARIABLE_TEMP_2
	RET
//----------------------------------------------------------------------------------------//
DISMINUYE_MES:
	LDS		VARIABLE_TEMP_1,	VALOR_MES_U		// LEE DE SRAM
	LDS		VARIABLE_TEMP_2,	VALOR_MES_D
	LDS		CONTADOR_MESES,		CONTEO_MESES
	
	LDI		ZL,		LOW(Cantidad_dias<<1)	// REINICIAMOS PUNTEROS DIAS
	LDI		ZH,		HIGH(Cantidad_dias<<1)
	ADD		ZL,		CONTADOR_MESES
	LPM		VARIABLE_DIAS,	Z

	CPI		VARIABLE_TEMP_2,	0x01		// REVISA PARA VER SI SON MESES 10, 11 Y 12
	BREQ	D_2_MESES

	D_1_MESES:
	DEC		CONTADOR_MESES					// DECREMENTA CONTADOR DE MESES
	DEC		VARIABLE_TEMP_1					// DECREMENTA VALOR DE UNIDADES
	CPI		VARIABLE_TEMP_1,	0x00		// COMPARO CON FF PARA VALIDAR 0
	BRNE	SALIDA_DECREMENTO_MES
	LDI		VARIABLE_TEMP_1,	0x02		// REINICIA CONTADOR DE UNIDADES
	LDI		R16,				0x0C		// REINICIO DE CONTADOR DE MESES POR UNDERFLOW SI UNIDADES LLEGAN A FF PORQUE
	MOV		CONTADOR_MESES,		R16			// SIGNIFICA QUE EL CONTADOR TAMBIEN LLEGO A SU LIMITE INFERIOR
	RJMP	D_D_MESES

	D_2_MESES:
	DEC		CONTADOR_MESES					// DECREMENTA CONTADOR DE MESES
	DEC		VARIABLE_TEMP_1					// DECREMENTA VALOR DE UNIDADES
	CPI		VARIABLE_TEMP_1,	0xFF		// COMPARO CON 3
	BRNE	SALIDA_DECREMENTO_MES
	LDI		VARIABLE_TEMP_1,	0x09		// REINICIAR VALORES DESPUES DE UNDERFLOW
	RJMP	D_D_MESES

	D_D_MESES:
	DEC		VARIABLE_TEMP_2					// AUMENTO VALOR DE DECENAS
	CPI		VARIABLE_TEMP_2,	0xFF		// COMPARO CON 2
	BRNE	SALIDA_DECREMENTO_MES
	LDI		VARIABLE_TEMP_2,	0x01		// REINICIO DE CONTADOR DE MESES
	LDI		VARIABLE_TEMP_1,	0x02		// REINICIO DE CONTADOR DE MESES
	SALIDA_DECREMENTO_MES:
	STS		VALOR_MES_U,		VARIABLE_TEMP_1	// GUARDA EN SRAM
	STS		VALOR_MES_D,		VARIABLE_TEMP_2
	STS		CONTEO_MESES,		CONTADOR_MESES
	RET
//----------------------------------------------------------------------------------------//
DISMINUYE_MIN_ALARMA:
	LDS		VARIABLE_TEMP_1,	A_MIN_U		// LEO DE SRAM
	LDS		VARIABLE_TEMP_2,	A_MIN_D

	DEC		VARIABLE_TEMP_1					// DECREMENTO VALOR DE UNIDADES
	CPI		VARIABLE_TEMP_1,	0xFF		// COMPARO CON FF PARA VALIDAR EL 0
	BRNE	SALIDA_ALARMA_DECREMENTO_MIN			
	LDI		VARIABLE_TEMP_1,	0x09		// REINICIO POR UNDERFLOW

	DEC		VARIABLE_TEMP_2					// AUMENTO VALOR DE DECENAS
	CPI		VARIABLE_TEMP_2,	0xFF		// COMPARO CON FF PARA VALIDAR EL 0
	BRNE	SALIDA_ALARMA_DECREMENTO_MIN
	LDI		VARIABLE_TEMP_2,	0x05		// REINICIO POR UNDERFLOW
SALIDA_ALARMA_DECREMENTO_MIN:
	STS		A_MIN_U,	VARIABLE_TEMP_1
	STS		A_MIN_D,	VARIABLE_TEMP_2
	RET
//----------------------------------------------------------------------------------------//
DISMINUYE_HORA_ALARMA:
	LDS		VARIABLE_TEMP_1,	A_HORA_U		// LEO EN SRAM
	LDS		VARIABLE_TEMP_2,	A_HORA_D

	DEC		VARIABLE_TEMP_1						// DECREMETO VALOR DE UNIDADES
	CPI		VARIABLE_TEMP_1,	0xFF			// COMPARO CON FF
	BRNE	SALIDA_ALARMA_DECREMENTO_HORA
	LDI		VARIABLE_TEMP_1,	0x09			// REINICIO CONTADOR DE UNIDADES
	RJMP	D_A_D_HORAS

D_A_D_HORAS:
	DEC		VARIABLE_TEMP_2						// AUMENTO VALOR DE DECENAS
	CPI		VARIABLE_TEMP_2,	0xFF			// COMPARO CON FF PARA VALIDAR 0
	BRNE	SALIDA_ALARMA_DECREMENTO_HORA
	LDI		VARIABLE_TEMP_2,	0x02			// REINICIO CONTADOR DE DECENAS
	LDI		VARIABLE_TEMP_1,	0x03			// REINICIO CONTADOR DE UNIDADES

SALIDA_ALARMA_DECREMENTO_HORA:
	STS		A_HORA_U,	VARIABLE_TEMP_1
	STS		A_HORA_D,	VARIABLE_TEMP_2
	RET
//----------------------------------------------------------------------------------------//
BUZZER:
	SBI		PORTC,				PINC5			// PONE EL BIT 5 DEL PORTC ACTIVADO PARA HACER SONAR EL BUZZER
	CBR		BANDERA_ESTADO,		(1<<2)			// LIMPIA BANDERA DE ALARMA CONFIGURADA
	RET
/****************************************/
// Interrupt routines
ISR_PCI1:
	PUSH	R16						// Store contents of R16 in stack
	IN		R16,	SREG			// Store SREG in R16
	PUSH	R16						// Store contents of R16 in stack

    SBIS	PINC,	PINC4			// REVISA SI LA INTERRUPCION FUE POR EL BIT 4 QUE CAMBIA MODO
	INC		MODO					// SI FUE POR BIT 4 AUMENTA EL MODO
	SBRC	BANDERA_ESTADO,	3		// AQUI REVISA POR LA BANDERA DE BUZZER ACTIVADO
	CBR		BANDERA_ESTADO,	(1<<3)	// SI ESTA ACTIVADA, APAGA LA BANDERA Y LUEGO APAGA EL BUZZER
	CP		MODO,	MAX_MODES		// COMPRUEBA CON EL MAXIMO DE MODOS
	BRNE	CONTINUAR
	CLR		MODO					// REINICIA POR OVERFLOW
CONTINUAR:
	LDI		R16,	2				// AQUI REVISA EN QUE MODO ESTA PARA ACTIVAR EL BIT DE LA BANDERA DE ACCION
	CP		MODO,	R16
	BREQ	MOD_RELOJ
	LDI		R16,	3
	CP		MODO,	R16
	BREQ	MOD_FECHA
	LDI		R16,	4
	CP		MODO,	R16
	BREQ	S_ALARMA
	RJMP	FINAL					// SI NO SE CUMPLE NINGUNO, SALTA HASTA EL FINAL
MOD_RELOJ:
	SBR		BANDERA_ACCION,	(1<<0)				// ACTIVA EL BIT 0 Y APAGA LOS DEMAS
	CBR		BANDERA_ACCION,	(1<<1) | (1<<2)
	RJMP	FINAL

MOD_FECHA:
	SBR		BANDERA_ACCION,	(1<<1)				// ACTIVA EL BIT 1 Y APAGA LOS DEMAS
	CBR		BANDERA_ACCION,	(1<<2) | (1<<0)
	RJMP	FINAL

S_ALARMA:
	SBR		BANDERA_ACCION,	(1<<2)				// ACTIVA EL BIT 2 Y APAGA LOS DEMAS
	CBR		BANDERA_ACCION,	(1<<1) | (1<<0)
	RJMP	FINAL
	
FINAL:
	LDI		R16,	0				// AQUI REVISA SI EL MODO AL QUE CAMBIO ES 0, YA QUE SIGNIFICA QUE CAMBIO DE SETEAR ALARMA A MODO RELOJ
	CP		MODO,	R16
	BRNE	EXIT_ISR_PCI1
	SBR		BANDERA_ESTADO,	(1<<2)	// POR LO QUE ACTIVA LA BANDERA DE ALARMA CONFIGURADA
EXIT_ISR_PCI1:		
	SBRS	BANDERA_ESTADO,	3		// AQUI REVISA SI LA BANDERA DE BUZZER ESTA ENCENDIDA Y LA APAGA SI ES VERDAD.
	CBI		PORTC,	PINC5
	POP		R16						// Get contents from stack and store into R16
	OUT		SREG,	R16				// Load previous contents into SREG
	POP		R16						// Get contents from stack and store into R16
	RETI
//----------------------------------------------------------------------------------------//
ISR_TMR0_OVF:
	PUSH	R16
	IN		R16,	SREG
	PUSH	R16

	LDI		R16,				131				// SE GUARDA EN R16 EL VALOR DE INICIO DEL TIMER
	OUT		TCNT0,				R16				// GUARDA VALORES INICIALES DE TIMER 0 EN TCNT0

	SBRC	BANDERA_ESTADO,		4				// REVISA BANDERA PARA APAGAR MULTIPLEXADO
	RJMP	APAGAR_DISPLAYS

	SWAP	CONTADOR_ESTADO						// AQUI HACE SWAP CON EL REGISTRO DE CONTADOR DE ESTADOS QUE TIENE QUE LEDS SE ENCIENDEN
	LDI		R16,				0x00			// LO QUE HACE QUE PASE HA SER LOS PRIMEROS 4 BITS
	CP		CONTADOR_MULTI,		R16				// AQUI REVISA EL CONTADOR DEL MULTIPLEXADO
	BREQ	MULTI_DISPLAY_1						// PARA MANDAR A ACTIVAR LOS DIFERENTES TRANSISTORES
	LDI		R16,				0x01
	CP		CONTADOR_MULTI,		R16
	BREQ	MULTI_DISPLAY_2
	LDI		R16,				0x02
	CP		CONTADOR_MULTI,		R16
	BREQ	MULTI_DISPLAY_3
	LDI		R16,				0x03
	CP		CONTADOR_MULTI,		R16
	BREQ	MULTI_DISPLAY_4

MULTI_DISPLAY_1:
	LDI		R16,		0x01					// AQUI CARGA EL VALOR PARA ENCENDER EL TRANSISTOR CORRESPONDIENTE
	OR		CONTADOR_ESTADO,	R16				// HACE UN OR CON EL CONTADOR DE ESTADOS PARA AGREGAR SUS BITS
	MOV		S_PORT,		CONTADOR_ESTADO			// Y LO MANDA A S_PORT PARA QUE SALGA EN LAS SALIDAS DE DISPLAY
	RJMP	FIN
MULTI_DISPLAY_2:
	LDI		R16,		0x02					// AQUI SUCEDE LO MISMO QUE ARRIBA, PERO CON OTRO TRANSISTOR
	OR		CONTADOR_ESTADO,	R16
	MOV		S_PORT,		CONTADOR_ESTADO
	RJMP	FIN
MULTI_DISPLAY_3:
	LDI		R16,		0x04					// AQUI SUCEDE LO MISMO QUE ARRIBA, PERO CON OTRO TRANSISTOR
	OR		CONTADOR_ESTADO,	R16
	MOV		S_PORT,		CONTADOR_ESTADO
	RJMP	FIN
MULTI_DISPLAY_4:
	LDI		R16,		0x08					// AQUI SUCEDE LO MISMO QUE ARRIBA, PERO CON OTRO TRANSISTOR
	OR		CONTADOR_ESTADO,	R16
	MOV		S_PORT,		CONTADOR_ESTADO
	RJMP	FIN

APAGAR_DISPLAYS:
	LDI		R16,			0xF0				// SALTA AQUI CUANDO LA BANDERA DE APAGAR MULTI ESTA ENCENDIDA
	OUT		PORTB,			R16					// LO QUE HACE ES DIRECTAMENTE MANDAR UN VALOR A PORTB PARA APAGAR LOS TRANSISTORES

FIN:
	LDI		R16,			0x03				// AQUI INCREMENTA EL CONTADOR DE MULTIPLEXADO
	INC		CONTADOR_MULTI						// LUEGO LE HACE UNA MASCARA PARA QUE NO SE PASE DE 3
	AND		CONTADOR_MULTI,	R16
	POP		R16
	OUT		SREG,	R16
	POP		R16
	RETI
//----------------------------------------------------------------------------------------//
ISR_TMR1_OVF:
	PUSH	R16
	IN		R16,	SREG
	PUSH	R16
	// ----------------------------------------------------------------------------------- //
	LDI		R16,	HIGH(TCNT1_value)	// CARGA VALORES INICIALES DE TIMER 1
	STS		TCNT1H,	R16
	LDI		R16,	LOW(TCNT1_value)
	STS		TCNT1L,	R16
	// ----------------------------------------------------------------------------------- //
	LDI		R16,			0x80		// AQUI HACE EL PARPADEO DE LEDS
	IN		PARPADEO_LED,	PORTD		// OBTIENE EL VALOR DEL PORTD
	ANDI	PARPADEO_LED,	0X80		// LUEGO SOLO SE QUEDA CON EL BIT 7
	EOR		PARPADEO_LED,	R16			// Y HACE UN XOR PARA IR TOGGLEANDOLO, LUEGO LO JUNTAMOS EN LAS SALIDAS DE DISPLAY CON LOS VALORES DE
										// LA TABLA
	SBRC	BANDERA_ESTADO,	2			// AQUI REVISA SI LA BANDERA DE ALARMA CONFIGURADA ESTA ENCENDIDA, SI ES ASI
	RJMP	PARPADEO_LED_ALARMA			// SALTA A HACER PARPADEAR LOS LEDS DE LA ALARMA
	CBR		BANDERA_ESTADO, (1<<4)		// APAGA LA BANDERA DE APAGAR MULTIPLEXADO
	RJMP	CONTINUAR_TIMER1
	PARPADEO_LED_ALARMA:
	LDI		R16,			4			// AQUI VERIFICA QUE ESTE EN MODO SETEO DE ALARMA
	CP		MODO,			R16
	BRNE	APAGAR_PARPADEO				// SI NO, SE SALTA LA SIGUIENTE PARTE
	LDI		R16,			0x10		// LE CARGA 01 A R16
	EOR		BANDERA_ESTADO,	R16			// PARA HACER UN XOR CON LA BANDERA DE ESTADOS
	RJMP	CONTINUAR_TIMER1
	APAGAR_PARPADEO:
	CBR		BANDERA_ESTADO, (1<<4)		// AQUI LIMPIA LA BANDERA DE APAGAR MULTIPLEXADO
	RJMP	CONTINUAR_TIMER1
	// ----------------------------------------------------------------------------------- //
	CONTINUAR_TIMER1:
	LDI		ZL,		LOW(Cantidad_dias<<1)	// REINICIAMOS PUNTEROS DIAS
	LDI		ZH,		HIGH(Cantidad_dias<<1)
	ADD		ZL,		CONTADOR_MESES
	LPM		VARIABLE_DIAS,	Z
	// ----------------------------------------------------------------------------------- //
	SBRS	BANDERA_ESTADO,		0			// VERIFICA SI LA BANDERA DE PROSEGUIR CON EL CONTADOR ESTA ENCENDIDA
	RJMP	REGRESO_1
	// ----------------------------------------------------------------------------------- //
	INC		CONTADOR_TIEMPO					// AUMENTA CONTADOR CADA 500 ms
	CPI		CONTADOR_TIEMPO,	120			// COMPARA CONTADOR CON 120 PARA HACER 1 MIN
	BRNE	REGRESO_1
	CLR		CONTADOR_TIEMPO					// REINICIO DE CONTADOR DE TIEMPO
	// ------------------------------------- minutos ------------------------------------- //
	LDS		VARIABLE_TEMP_1,	VALOR_MIN_U		// LEE DE SRAM
	LDS		VARIABLE_TEMP_2,	VALOR_MIN_D

	INC		VARIABLE_TEMP_1						// AUMENTO VALOR DE UNIDADES
	STS		VALOR_MIN_U,		VARIABLE_TEMP_1	// VA GUARDANDO CADA MODIFICACION
	CPI		VARIABLE_TEMP_1,	0x0A			// COMPARO CON 10
	BRNE	VERIFICAR_ALARMA
	CLR		VARIABLE_TEMP_1
	STS		VALOR_MIN_U,		VARIABLE_TEMP_1
	
	INC		VARIABLE_TEMP_2						// AUMENTO VALOR DE DECENAS
	STS		VALOR_MIN_D,		VARIABLE_TEMP_2
	CPI		VARIABLE_TEMP_2,	0x06			// COMPARO CON 6
	BRNE	VERIFICAR_ALARMA
	CLR		VARIABLE_TEMP_2
	STS		VALOR_MIN_D,		VARIABLE_TEMP_2

	// ------------------------------------- HORAS --------------------------------------- //
	LDS		VARIABLE_TEMP_1,	VALOR_HORA_U	// LEE DE SRAM
	LDS		VARIABLE_TEMP_2,	VALOR_HORA_D

	CPI		VARIABLE_TEMP_2,	0x02		// COMPRUEBA SI ESTA EN LOS 20
	BREQ	CONTEO_2_HORAS

CONTEO_1_HORAS:
	INC		VARIABLE_TEMP_1					// AUMENTO VALOR DE UNIDADES
	STS		VALOR_HORA_U,		VARIABLE_TEMP_1
	CPI		VARIABLE_TEMP_1,	0x0A		// COMPARO CON 10
	BRNE	VERIFICAR_ALARMA
	CLR		VARIABLE_TEMP_1					// REINICIO CONTADOR DE UNIDADES
	STS		VALOR_HORA_U,		VARIABLE_TEMP_1 // GUARDA CADA CAMBIO
	RJMP	CONTEO_D_HORAS

CONTEO_2_HORAS:
	INC		VARIABLE_TEMP_1					// AUMENTO VALOR DE UNIDADES
	STS		VALOR_HORA_U,		VARIABLE_TEMP_1
	CPI		VARIABLE_TEMP_1,	0x04		// COMPARO CON 4
	BRNE	VERIFICAR_ALARMA
	CLR		VARIABLE_TEMP_1					// REINICIO CONTADOR DE UNIDADES
	STS		VALOR_HORA_U,		VARIABLE_TEMP_1
	RJMP	CONTEO_D_HORAS

CONTEO_D_HORAS:
	INC		VARIABLE_TEMP_2					// AUMENTO VALOR DE DECENAS
	STS		VALOR_HORA_D,		VARIABLE_TEMP_2
	CPI		VARIABLE_TEMP_2,	0x03		// COMPARO CON 3
	BRNE	VERIFICAR_ALARMA				// DE AQUI SALTA A VERIFICAR LA ALARMA
	CLR		VARIABLE_TEMP_2					// REINICIO CONTADOR DE DECENAS
	CLR		VARIABLE_TEMP_1					// REINICIO CONTADOR DE UNIDADES
	STS		VALOR_HORA_D,		VARIABLE_TEMP_2	// GUARDA EN SRAM
	STS		VALOR_HORA_U,		VARIABLE_TEMP_1
	RJMP	FECHA_TIMER
	
REGRESO_1:
	RJMP	REGRESO

VERIFICAR_ALARMA:
	SBRS    BANDERA_ESTADO,     2			// CUANDO VERIFICA LA ALARMA REVISA SI LA BANDERA DE ALARMA CONFIGURADA ESTA ENCENDIDA
    RJMP    REGRESO_ALARMA					// SI NO, SE SALTA ESTA PARTE
    LDS     VARIABLE_TEMP_1,    VALOR_MIN_U	// VA COMPARANDO VALOR POR VALOR
    LDS     VARIABLE_TEMP_2,    A_MIN_U
    CP      VARIABLE_TEMP_1,    VARIABLE_TEMP_2
    BRNE    REGRESO_ALARMA					// SI HAY ALGUNA DIFERENCIA SALE DE LA REVISION
    LDS     VARIABLE_TEMP_1,    VALOR_MIN_D
    LDS     VARIABLE_TEMP_2,    A_MIN_D
    CP      VARIABLE_TEMP_1,    VARIABLE_TEMP_2
    BRNE    REGRESO_ALARMA
    LDS     VARIABLE_TEMP_1,    VALOR_HORA_U
    LDS     VARIABLE_TEMP_2,    A_HORA_U
    CP      VARIABLE_TEMP_1,    VARIABLE_TEMP_2
    BRNE    REGRESO_ALARMA
    LDS     VARIABLE_TEMP_1,    VALOR_HORA_D
    LDS     VARIABLE_TEMP_2,    A_HORA_D
    CP      VARIABLE_TEMP_1,    VARIABLE_TEMP_2
    BRNE    REGRESO_ALARMA
ACTIVAR_BUZZER:
	SBR		BANDERA_ESTADO,		(1<<3)	// SI HAY UN MATCH, ENTONCES LO QUE HACE ES ENCENDER LA BANDER DE BUZZER
REGRESO_ALARMA:
	RJMP	REGRESO

FECHA_TIMER:
	// ------------------------------------- DIAS --------------------------------------- //
	LDS		VARIABLE_TEMP_1,	VALOR_DIA_U	// LEE DE SRAM
	LDS		VARIABLE_TEMP_2,	VALOR_DIA_D

	CPI		VARIABLE_TEMP_2,	0x03		// COMPARA PARA VER SI ESTA EN 30
	BREQ	CONTADOR_3_DIAS
	CPI		VARIABLE_TEMP_2,	0x02		// COMPARA PARA VER SI ESTA EN 20
	BREQ	CONTADOR_2_DIAS

CONTADOR_1_DIAS:
	INC		VARIABLE_TEMP_1					// AUMENTO VALOR DE UNIDADES
	STS		VALOR_DIA_U,		VARIABLE_TEMP_1
	CPI		VARIABLE_TEMP_1,	0x0A		// COMPARO CON 2
	BRNE	REGRESO_3
	CLR		VARIABLE_TEMP_1
	STS		VALOR_DIA_U,		VARIABLE_TEMP_1
	RJMP	CONTEO_D_DIAS

REGRESO_3:
	RJMP	REGRESO

CONTADOR_2_DIAS:
	LDI		R16,	28						// EN LOS 20, REVISA SI EL LIMITE DE DIAS ES 28
	CP		VARIABLE_DIAS,	R16
	BREQ	CONTEO_2_FEBRERO_DIAS			// SI ASI ES, ENTONCES SALTA A EL CONTADOR DE FEBRERO
	INC		VARIABLE_TEMP_1					// AUMENTO VALOR DE UNIDADES
	STS		VALOR_DIA_U,		VARIABLE_TEMP_1
	CPI		VARIABLE_TEMP_1,	0x0A		// COMPARO CON 10
	BRNE	REGRESO_2
	CLR		VARIABLE_TEMP_1
	STS		VALOR_DIA_U,		VARIABLE_TEMP_1
	RJMP	CONTEO_D_DIAS
	CONTEO_2_FEBRERO_DIAS:
	INC		VARIABLE_TEMP_1					// AUMENTO VALOR DE UNIDADES
	STS		VALOR_DIA_U,		VARIABLE_TEMP_1
	CPI		VARIABLE_TEMP_1,	0x09		// COMPARO CON 9
	BRNE	REGRESO_2
	CLR		VARIABLE_TEMP_2					// REINICIA LOS CONTADORES
    LDI		VARIABLE_TEMP_1, 0x01
	STS		VALOR_DIA_D,		VARIABLE_TEMP_2	// GUARDA EN SRAM
	STS		VALOR_DIA_U,		VARIABLE_TEMP_1
    RJMP	REGRESO_2						// Y SALTA DIRECTAMENTE A SALIDA

CONTADOR_3_DIAS:
	LDI		R16,	31						// AQUI VERIFICA SI EL LIMITE ES 31
	CP		VARIABLE_DIAS,	R16
	BREQ	CONTEO_3_1_DIAS					// SI ASI ES, SALTA A SU CONTADOR RESPECTIVO
	LDI		R16,	30
	CP		VARIABLE_DIAS,	R16				// AQUI VERIFICA SI EL LIMITE ES 30
	BREQ	CONTEO_3_2_DIAS					// SI ASI ES, SALTA A SU CONTADOR RESPECTIVO
	RJMP	REGRESO_2
	CONTEO_3_1_DIAS:
	INC		VARIABLE_TEMP_1					// AUMENTO VALOR DE UNIDADES
	STS		VALOR_DIA_U,		VARIABLE_TEMP_1
	CPI		VARIABLE_TEMP_1,	0x02		// COMPARO CON 2
	BRNE	REGRESO_2
	CLR		VARIABLE_TEMP_1					// REINICIA VARIABLES
	STS		VALOR_DIA_U,		VARIABLE_TEMP_1 // Y LAS GUARDA
	RJMP	CONTEO_D_DIAS
	CONTEO_3_2_DIAS:
	INC		VARIABLE_TEMP_1					// AUMENTO VALOR DE UNIDADES
	STS		VALOR_DIA_U,		VARIABLE_TEMP_1
	CPI		VARIABLE_TEMP_1,	0x01			// COMPARO CON 1
	BRNE	REGRESO_2
	CLR		VARIABLE_TEMP_1
	STS		VALOR_DIA_U,		VARIABLE_TEMP_1
	RJMP	CONTEO_D_DIAS
	
CONTEO_D_DIAS:
	INC		VARIABLE_TEMP_2					// AUMENTO VALOR DE DECENAS
	STS		VALOR_DIA_D,		VARIABLE_TEMP_2
	CPI		VARIABLE_TEMP_2,	0x04		// COMPARO CON 4
	BRNE	REGRESO_2
	CLR		VARIABLE_TEMP_2					// REINICIA CONTADOR DE DIAS EN DECENAS Y UNIDADES
	LDI		VARIABLE_TEMP_1,	0x01
	STS		VALOR_DIA_D,		VARIABLE_TEMP_2
	STS		VALOR_DIA_U,		VARIABLE_TEMP_1
	RJMP	FECHA_MES						// SALTA A MESES

REGRESO_2:
	RJMP	REGRESO

	// ------------------------------------- MESES --------------------------------------- //
FECHA_MES:
	LDS		VARIABLE_TEMP_1,	VALOR_MES_U	// LEE DE SRAM
	LDS		VARIABLE_TEMP_2,	VALOR_MES_D
	LDS		CONTADOR_MESES,		CONTEO_MESES
	CPI		VARIABLE_TEMP_2,	0x01		// REVISA PARA VER SI ESTA EN MESES 10, 11 O 12
	BREQ	CONTADOR_2_MESES

CONTADOR_1_MESES:
	INC		CONTADOR_MESES					// INCREMENTA EL CONTADOR DE MESES
	INC		VARIABLE_TEMP_1					// AUMENTO VALOR DE UNIDADES
	STS		VALOR_MES_U,		VARIABLE_TEMP_1
	STS		CONTEO_MESES,		CONTADOR_MESES
	CPI		VARIABLE_TEMP_1,	0x0A		// COMPARO CON 10
	BRNE	REGRESO
	CLR		VARIABLE_TEMP_1	
	STS		VALOR_MES_U,		VARIABLE_TEMP_1
	RJMP	CONTEO_D_MESES
CONTADOR_2_MESES:
	INC		CONTADOR_MESES					// INCREMENTA EL CONTADOR DE MESES
	INC		VARIABLE_TEMP_1					// AUMENTO VALOR DE UNIDADES
	STS		VALOR_MES_U,		VARIABLE_TEMP_1
	STS		CONTEO_MESES,		CONTADOR_MESES
	CPI		VARIABLE_TEMP_1,	0x03		// COMPARO CON 3
	BRNE	REGRESO
	LDI		VARIABLE_TEMP_1,	0x01
	LDI		R16,			0x01
	MOV		CONTADOR_MESES,	R16				// SI HACE OVERFLOW, LO REINICIA A 1
	STS		VALOR_MES_U,		VARIABLE_TEMP_1
	STS		CONTEO_MESES,		CONTADOR_MESES
	RJMP	CONTEO_D_MESES

CONTEO_D_MESES:
	INC		VARIABLE_TEMP_2					// AUMENTO VALOR DE DECENAS
	STS		VALOR_MES_D,		VARIABLE_TEMP_2
	CPI		VARIABLE_TEMP_2,	0x02			// COMPARO CON 2
	BRNE	REGRESO
	CLR		VARIABLE_TEMP_2
	LDI		VARIABLE_TEMP_1,	0x01
	MOV		CONTADOR_MESES,	VARIABLE_TEMP_1
	STS		VALOR_MES_D,		VARIABLE_TEMP_2
	STS		VALOR_MES_U,		VARIABLE_TEMP_1
	STS		CONTEO_MESES,		CONTADOR_MESES

REGRESO:
	//-------------------------------------------------------------------------------------//
	POP		R16
	OUT		SREG,	R16
	POP		R16
	RETI
/****************************************/